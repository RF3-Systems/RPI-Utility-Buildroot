## rf3-pi-util-br2ext/Config.in
```kconfig
# RF3 Pi utility external configuration
menu "RF3 packages"

source "$BR2_EXTERNAL_RF3_PI_UTIL_PATH/package/rust-cargo-hello-world/Config.in"

endmenu
```

## rf3-pi-util-br2ext/package/rust-cargo-hello-world/Config.in
```kconfig
config BR2_PACKAGE_RUST_CARGO_HELLO_WORLD
	bool "rust_hello_world"
	depends on BR2_PACKAGE_HOST_RUSTC_TARGET_ARCH_SUPPORTS
	select BR2_PACKAGE_HOST_RUSTC
	help
	  This is a skeleton for cargo projects.
```
